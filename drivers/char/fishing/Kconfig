## drivers/char/fishing/Kconfig
```kconfig
config FISHING_POLE
		tristate "Fish Master 3000 support"
		default n
		help
		  if you say Y here,support for the Fish Master 3000 with computer
		  interface will be compiled into the kernel and accessible via a
		  device node. You can also say M here and the driver will be built
		  as a moudle named fishing.ko.

		  If unsure, say N.
```
